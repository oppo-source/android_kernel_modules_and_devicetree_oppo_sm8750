&actuator_tele {
    pid_version = <0x10>;
    pid_version_verify = <
        'W'  0x02  0x40  0x03

        'R'  0x03  0x1C  0xFF
        'R'  0x2B  0xD7  0xFF
    >;
    pid_update_setting = <
        'W'  0xAE  0x3B  0x00
        'W'  0x0B  0x82  0x00
        'W'  0x0A  0x03  0x00
        'W'  0x0E  0x88  0x00
        'W'  0x0F  0xC1  0x00
        'W'  0x08  0x1E  0x00
        'W'  0x09  0x20  0x00
        'W'  0x10  0x78  0x00
        'W'  0x11  0x78  0x00
        'W'  0x12  0xDC  0x00
        'W'  0x13  0x19  0x00
        'W'  0x14  0x0E  0x00
        'W'  0x15  0x3F  0x00
        'W'  0x16  0x10  0x00
        'W'  0x17  0x78  0x00
        'W'  0x18  0xAA  0x00
        'W'  0x1A  0x00  0x00
        'W'  0x1B  0x50  0x00
        'W'  0x1C  0x9C  0x00
        'W'  0x1D  0xB6  0x00
        'W'  0x1E  0xB4  0x00
        'W'  0x1F  0x0A  0x00
        'W'  0x20  0x3C  0x00
        'W'  0x21  0x23  0x00
        'W'  0x22  0x88  0x00
        'W'  0x23  0x50  0x00
        'W'  0x24  0x88  0x00
        'W'  0x25  0x78  0x00
        'W'  0x26  0xC1  0x00
        'W'  0x27  0x79  0x00
        'W'  0x28  0x7E  0x00
        'W'  0x29  0x85  0x00
        'W'  0x2A  0x34  0x00
        'W'  0x2B  0xD7  0x00
        'W'  0x2C  0x95  0x00
        'W'  0x2D  0xB0  0x00
        'W'  0x2E  0x35  0x00
        'W'  0x2F  0x7B  0x00
        'W'  0x30  0x70  0x00
        'W'  0x31  0x28  0x00
        'W'  0x32  0x70  0x00
        'W'  0x33  0x41  0x00
        'W'  0x34  0x90  0x00
        'W'  0x35  0x3C  0x00
        'W'  0x36  0x79  0x00
        'W'  0x3C  0x50  0x00
        'W'  0x3D  0xCD  0x00
        'W'  0x52  0x0F  0x00
        'W'  0x53  0x64  0x00
        'W'  0x54  0x00  0x00
        'W'  0x55  0x00  0x00
        'W'  0x50  0x46  0x00
        'W'  0x51  0xD8  0x00
        'W'  0x56  0x23  0x00
        'W'  0x57  0xB4  0x00
        'W'  0x58  0x40  0x00
        'W'  0x59  0x0B  0x00
        'W'  0x5A  0x00  0x00
        'W'  0x5B  0x02  0x00
        'W'  0x5C  0x32  0x00
        'W'  0x5E  0x00  0x00
        'W'  0x5F  0x00  0x00
        'W'  0xC4  0x0A  0x00

        'W'  0x03  0x01  0x65
        'W'  0x03  0x02  0xB5
        'W'  0x03  0x04  0x97
        'W'  0x03  0x08  0xA1

        'R'  0x4B  0x00  0x04
        'W'  0xAE  0x00  0x00
    >;
    pid_post_verify = <
        'R'  0x2B  0xD7  0xFF
    >;
    pid_settings_addr_type = <1>;
    pid_settings_data_type = <1>;
};
