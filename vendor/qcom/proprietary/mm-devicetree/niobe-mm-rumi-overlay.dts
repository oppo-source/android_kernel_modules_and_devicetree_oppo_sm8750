/dts-v1/;
/plugin/;

#include "hw_fence/niobe-hw-fence.dtsi"

/ {
	model = "Qualcomm Technologies, Inc. Niobe RUMI";
	compatible = "qcom,niobe-rumi", "qcom,niobe", "qcom,rumi";
	qcom,msm-id = <629 0x10000>;
	qcom,board-id = <15 0>;
};
