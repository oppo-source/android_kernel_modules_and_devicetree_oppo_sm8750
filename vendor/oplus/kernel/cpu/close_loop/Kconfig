## vendor/oplus/kernel/cpu/close_loop/Kconfig
```kconfig
# SPDX-License-Identifier: GPL-2.0-only
# Copyright (C) 2018-2020 Oplus. All rights reserved.

config OPLUS_FEATURE_CPU_CLOSE_LOOP
    tristate "close loop to reclaim over give performace"
    default n
    help
     According to frame render process, take render finish to to if we can
     have some performance back.
```

## vendor/oplus/kernel/mm/aizerofs/Kconfig
```kconfig
# SPDX-License-Identifier: GPL-2.0-only
# Copyright (C) 2020-2025 Oplus. All rights reserved.
config OPLUS_FEATURE_AIZEROCOPY
	tristate "AI zero copy"
	select DMA_SHARED_BUFFER
	default n
	help
	  Enable AI zero copy

config AIZEROFS_DEBUG_SYS_ABI
	bool "aizerofs sysfs debug abi"
	depends on OPLUS_FEATURE_AIZEROCOPY
	default y
	help
	  support aizerofs sysfs debug
```
