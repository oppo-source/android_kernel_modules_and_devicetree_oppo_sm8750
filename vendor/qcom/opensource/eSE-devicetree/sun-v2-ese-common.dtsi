// SPDX-License-Identifier: BSD-3-Clause

/*
 * Copyright (c) 2024 Qualcomm Innovation Center, Inc. All rights reserved.
 */

&soc {
    st54spi_gpio {
        status = "ok";
        compatible = "st,st54spi_gpio";
        /* gpio used as SE_nRESET */
        gpio-power_nreset = <&tlmm 46 0x00>;
    };
};
