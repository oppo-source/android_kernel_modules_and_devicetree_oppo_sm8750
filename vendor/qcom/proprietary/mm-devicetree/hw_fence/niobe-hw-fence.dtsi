#include <dt-bindings/interrupt-controller/arm-gic.h>

&soc {
	msm_hw_fence: qcom,hw-fence {
		compatible = "qcom,msm-hw-fence";
		status = "ok";

		/* SOCCP properties */
		interrupts = <GIC_SPI 70 IRQ_TYPE_LEVEL_HIGH>;
		interrupt-controller;
		#interrupt-cells = <1>;
		iommus = <&apps_smmu 0x561 0x0>;
		dma-coherent;
		soccp_controller = <&soccp_pas>;

		qcom,hw-fence-table-entries = <8192>;
		qcom,hw-fence-queue-entries = <800>;
		qcom,ipcc-reg = <0x400000 0x200000>;

		/* time register */
		qcom,qtime-reg = <0xC221000 0x1000>;

		/* ipc version */
		qcom,hw-fence-ipc-ver = <0x20B04>;

		/* base client queue properties */
		qcom,hw-fence-client-type-dpu = <0 1 128 1>;
		qcom,hw-fence-client-type-val = <7 2 128 0>;
		qcom,hw-fence-client-type-ipa = <1 1 800 0>;
		qcom,hw-fence-client-type-vpu = <1 2 800 0>;
		qcom,hw-fence-client-type-ife0 = <16 1 128 1>;
		qcom,hw-fence-client-type-ife1 = <16 1 128 1>;
		qcom,hw-fence-client-type-ife2 = <8 1 128 1>;
		qcom,hw-fence-client-type-ife3 = <8 1 128 1>;
		qcom,hw-fence-client-type-ife4 = <8 1 128 1>;
		qcom,hw-fence-client-type-ife5 = <8 1 128 1>;
		qcom,hw-fence-client-type-ife6 = <8 1 128 1>;
		qcom,hw-fence-client-type-ife7 = <8 1 128 1>;
		qcom,hw-fence-client-type-ife8 = <8 1 128 1>;
		qcom,hw-fence-client-type-ife9 = <8 1 128 1>;
		qcom,hw-fence-client-type-ife10 = <8 1 128 1>;
		qcom,hw-fence-client-type-ife11 = <8 1 128 1>;

		/* extra client properties */
		qcom,hw-fence-client-type-ipa-extra = <0 0 0 0 1>;

		/* haven io-mem specific */
		hw_fence@1 {
			compatible = "qcom,msm-hw-fence-mem";
			qcom,master;
			shared-buffer = <&hwfence_shbuf>;
		};
	};
};
