/dts-v1/;
/plugin/;


#include "hw_fence/niobe-hw-fence.dtsi"

/ {
	model = "Qualcomm Technologies, Inc. Niobe ATP";
	compatible = "qcom,niobe-atp", "qcom,niobe", "qcom,atp";
	qcom,msm-id = <652 0x10000>;
	qcom,board-id = <0x10021 0>;
};
