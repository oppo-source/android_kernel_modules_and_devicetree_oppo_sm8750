&actuator_tele {
    pid_version_verify = <
        'W'  0x02  0x40  0x03

        'R'  0x10  0x78  0xFF
        'R'  0x11  0xB4  0xFF
        'R'  0x12  0xCA  0xFF
        'R'  0x13  0x18  0xFF
        'R'  0x14  0x14  0xFF
        'R'  0x15  0x3F  0xFF
        'R'  0x16  0x10  0xFF
        'R'  0x17  0x8A  0xFF
        'R'  0x18  0xAA  0xFF
        'R'  0x1A  0x00  0xFF
        'R'  0x1B  0x14  0xFF
        'R'  0x1C  0xB4  0xFF
        'R'  0x1D  0xB4  0xFF
        'R'  0x1E  0xE8  0xFF
        'R'  0x1F  0x0F  0xFF
        'R'  0x20  0x4A  0xFF
        'R'  0x21  0x62  0xFF
        'R'  0x22  0x00  0xFF
        'R'  0x23  0xB4  0xFF
        'R'  0x24  0xF6  0xFF
        'R'  0x25  0x08  0xFF
        'R'  0x26  0xCC  0xFF
        'R'  0x27  0x7F  0xFF
        'R'  0x28  0x72  0xFF
        'R'  0x29  0xAA  0xFF
        'R'  0x2A  0x1E  0xFF
        'R'  0x2B  0x7E  0xFF
        'R'  0x2C  0xBF  0xFF
        'R'  0x2D  0xAF  0xFF
        'R'  0x2E  0x22  0xFF
        'R'  0x2F  0xAA  0xFF
        'R'  0x30  0xE0  0xFF
        'R'  0x31  0x3C  0xFF
        'R'  0x32  0x30  0xFF
        'R'  0x33  0x28  0xFF
        'R'  0x34  0x90  0xFF
        'R'  0x35  0x3C  0xFF
        'R'  0x36  0x79  0xFF
        'R'  0x3D  0xCD  0xFF
        'R'  0x52  0x0F  0xFF
        'R'  0x53  0x64  0xFF
        'R'  0x54  0x00  0xFF
        'R'  0x55  0x00  0xFF
    >;
    pid_update_setting = <
        'W'  0x02  0x40  0x03
        'W'  0xAE  0x3B  0x00
        'W'  0x0B  0xA2  0x00
        'W'  0x0A  0x03  0x00
        'W'  0x0E  0x80  0x00
        'W'  0x0F  0xC1  0x00
        'W'  0x08  0x1E  0x00
        'W'  0x09  0x00  0x00
        'W'  0x10  0x53  0x00
        'W'  0x11  0x6E  0x00
        'W'  0x12  0x44  0x00
        'W'  0x13  0x26  0x00
        'W'  0x14  0x17  0x00
        'W'  0x15  0x06  0x00
        'W'  0x16  0x20  0x00
        'W'  0x17  0x7F  0x00
        'W'  0x18  0x9A  0x00
        'W'  0x18  0x9A  0x00
        'W'  0x1A  0x00  0x00
        'W'  0x1B  0x7E  0x00
        'W'  0x1C  0x82  0x00
        'W'  0x1D  0xA0  0x00
        'W'  0x1E  0xC8  0x00
        'W'  0x1F  0x08  0x00
        'W'  0x20  0x7F  0x00
        'W'  0x21  0x0B  0x00
        'W'  0x22  0x0B  0x00
        'W'  0x23  0x14  0x00
        'W'  0x24  0x7F  0x00
        'W'  0x25  0x88  0x00
        'W'  0x26  0xC4  0x00
        'W'  0x27  0xF2  0x00
        'W'  0x28  0x7A  0x00
        'W'  0x29  0xE6  0x00
        'W'  0x2A  0x37  0x00
        'W'  0x2B  0x58  0x00
        'W'  0x2C  0x85  0x00
        'W'  0x2D  0x1A  0x00
        'W'  0x2E  0x43  0x00
        'W'  0x2F  0xB6  0x00
        'W'  0x30  0x70  0x00
        'W'  0x31  0x50  0x00
        'W'  0x32  0x77  0x00
        'W'  0x33  0xB4  0x00
        'W'  0x34  0x08  0x00
        'W'  0x35  0x14  0x00
        'W'  0x36  0x0C  0x00
        'W'  0x3C  0x50  0x00
        'W'  0x3D  0x81  0x00
        'W'  0x52  0x19  0x00
        'W'  0x53  0x50  0x00
        'W'  0x54  0x14  0x00
        'W'  0x55  0x32  0x00
        'W'  0x50  0x46  0x00
        'W'  0x51  0x08  0x00
        'W'  0x56  0x23  0x00
        'W'  0x57  0xB4  0x00
        'W'  0x58  0x40  0x00
        'W'  0x59  0x0B  0x00
        'W'  0x5A  0x00  0x00
        'W'  0x5B  0x02  0x00
        'W'  0x5C  0x32  0x00
        'W'  0x5E  0x00  0x00
        'W'  0x5F  0x00  0x00
        'W'  0xC4  0x00  0x00

        'W'  0x03  0x01  0x66
        'W'  0x03  0x02  0xB5
        'W'  0x03  0x04  0x97
        'W'  0x03  0x08  0xA1

        'R'  0x4B  0x00  0x04
        'W'  0xAE  0x00  0x00
    >;
    pid_post_verify = <
        'W'  0x02  0x40  0x03

        'R'  0x0A  0x03  0xFF
        'R'  0x0B  0xA2  0xFF
        'R'  0x0E  0x80  0xFF
        'R'  0x0F  0xC1  0xFF
        'R'  0x08  0x1E  0xFF
        'R'  0x09  0x00  0xFF
        'R'  0x10  0x53  0xFF
        'R'  0x11  0x6E  0xFF
        'R'  0x12  0x44  0xFF
        'R'  0x13  0x26  0xFF
        'R'  0x14  0x17  0xFF
        'R'  0x15  0x06  0xFF
        'R'  0x16  0x20  0xFF
        'R'  0x17  0x7F  0xFF
        'R'  0x18  0x9A  0xFF
        'R'  0x1A  0x00  0xFF
        'R'  0x1B  0x7E  0xFF
        'R'  0x1C  0x82  0xFF
        'R'  0x1D  0xA0  0xFF
        'R'  0x1E  0xC8  0xFF
        'R'  0x1F  0x08  0xFF
        'R'  0x20  0x7F  0xFF
        'R'  0x21  0x0B  0xFF
        'R'  0x22  0x0B  0xFF
        'R'  0x23  0x14  0xFF
        'R'  0x24  0x7F  0xFF
    >;
    pid_settings_addr_type = <1>;
    pid_settings_data_type = <1>;
};
